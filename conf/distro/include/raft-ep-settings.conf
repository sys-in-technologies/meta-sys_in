## conf/distro/include/raft-ep-settings.conf
```bitbake
SDK_VENDOR = "-raftsdk"
SDK_VERSION = "${@d.getVar('DISTRO_VERSION').replace('snapshot-${METADATA_REVISION}', 'snapshot')}"
SDK_VERSION[vardepvalue] = "${SDK_VERSION}"

MAINTAINER = "Raft Maintainers <zhangjian@sys-in.com.cn>"

TARGET_VENDOR = "-raft"

LOCALCONF_VERSION = "1"

# Override these in poky based distros
RAFT_FEATURES = "usrmerge"
RAFT_EXTRA_RDEPENDS = "packagegroup-core-boot"
RAFT_EXTRA_RRECOMMENDS = "kernel-module-af-packet"

DISTRO_FEATURES ?= "${DISTRO_FEATURES_DEFAULT} ${RAFT_FEATURES}"
DISTRO_FEATURES:remove = "pci 3g nfc ptest multiarch wayland vulkan bluetoothi busybox"

DISTRO_EXTRA_RDEPENDS += "${POKY_DEFAULT_EXTRA_RDEPENDS}"
DISTRO_EXTRA_RRECOMMENDS += "${POKY_DEFAULT_EXTRA_RRECOMMENDS}"

# sdk setup
require conf/distro/include/yocto-uninative.inc
INHERIT += "uninative"

SDK_NAME = "${DISTRO}-${TCLIBC}-${SDKMACHINE}-${IMAGE_BASENAME}-${TUNE_PKGARCH}-${MACHINE}"
SDKPATHINSTALL = "/opt/${DISTRO}/${SDK_VERSION}"

# kernel and bootloader
PREFERRED_PROVIDER_virtual/bootloader = "u-boot"
PREFERRED_VERSION_u-boot = "2024.07"

PREFERRED_PROVIDER_virtual/kernel = "linux-mainline"
PREFERRED_VERSION_linux_mainline = "6.10%"
KERNEL_FEATURES:remove = "cfg/fs/vfat.scc"

IMAGE_BOOT_FILES ?= "\
    ${KERNEL_IMAGETYPE} \
    ${KERNEL_DEVICETREE_FILE} \
    "
IMAGE_FSTYPES += "tar.bz2 ext4 wic wic.bmap"

# system
#RAFT_INIT_MANAGER = "sysvinit"
#SYSVINIT_ENABLED_GETTYS = ""

RAFT_INIT_MANAGER = "systemd"
INIT_MANAGER ?= "${RAFT_INIT_MANAGER}"

TCLIBCAPPEND = "-${TCLIBC}"

PACKAGE_CLASSES ?= "package_deb"

require conf/distro/include/no-static-libs.inc
require conf/distro/include/security_flags.inc

# support
SANITY_TESTED_DISTROS ?= " \
            poky-4.3 \n \
            poky-5.0 \n \
            ubuntu-20.04 \n \
            ubuntu-22.04 \n \
            ubuntu-23.04 \n \
            fedora-38 \n \
            fedora-39 \n \
            centosstream-8 \n \
            debian-11 \n \
            debian-12 \n \
            opensuseleap-15.4 \n \
            almalinux-8.8 \n \
            almalinux-9.2 \n \
            rocky-9 \n \
            "
INHERIT += "poky-sanity"

# QA check settings - a little stricter than the OE-Core defaults
# (none currently necessary as we now match OE-Core)
#WARN_TO_ERROR_QA = "X"
#WARN_QA_remove = "${WARN_TO_ERROR_QA}"
#ERROR_QA_append = " ${WARN_TO_ERROR_QA}"

BB_SIGNATURE_HANDLER ?= "OEEquivHash"
BB_HASHSERVE ??= "auto"

# We need debug symbols so that SPDX license manifests for the kernel work
KERNEL_EXTRA_FEATURES:append = " features/debug/debug-kernel.scc"

# Enable creation of SPDX manifests by default
INHERIT += "create-spdx"

WKS_FILE_DEPENDS ?= " \
    mtools-native \
    dosfstools-native \
    virtual/bootloader \
    virtual/kernel \
    "
```

## conf/distro/raft-ep-poky.conf
```bitbake
include conf/distro/include/raft-ep-settings.conf

DISTRO = "raft-ep-poky"
DISTRO_NAME = "Raft Endpoint"
DISTRO_VERSION = "0.1+snapshot-${METADATA_REVISION}"
DISTRO_CODENAME = "xihu"

WKS_FILE ?= "raft-ep-neon-va-poky.wks"
```

## conf/distro/raft-ep-ubuntu.conf
```bitbake
include conf/distro/include/raft-ep-settings.conf

DISTRO = "raft-ep-ubuntu"
DISTRO_NAME = "Raft Endpoint"
DISTRO_VERSION = "0.1+snapshot-${METADATA_REVISION}"
DISTRO_CODENAME = "xihu"

WKS_FILE ?= "raft-ep-neon-va-ubuntu.wks"
```

## conf/machine/raft-ep-neon-va.conf
```bitbake
#@TYPE: Machine
#@NAME: Raft-EP-Neon-VA (T113-S3)
#@DESCRIPTION: Reference machine configuration for Raft EP Neon Variation A board.

require conf/machine/include/arm/armv7a/tune-cortexa7.inc
SOC_FAMILY = "sun8i"
MACHINEOVERRIDES =. "sun8i"

UBOOT_MACHINE = "raft_ep_neon_va_defconfig"
UBOOT_BINARY = "u-boot-sunxi-with-spl.bin"

KBRANCH = "master"
KERNEL_IMAGETYPE = "zImage"
KBUILD_DEFCONFIG = "sunxi_defconfig"
KCONFIG_MODE = "alldefconfig"
KERNEL_DEVICETREE_FILE = "sun8i-t113s-raft-ep-neon-va.dtb"
KERNEL_DEVICETREE = "allwinner/${KERNEL_DEVICETREE_FILE}"

SERIAL_CONSOLES ?= "115200;ttyS0"

MACHINE_ESSENTIAL_EXTRA_RRECOMMENDS = " kernel-modules"
MACHINE_ESSENTIAL_EXTRA_RDEPENDS = "kernel-image kernel-devicetree"
MACHINE_FEATURES ?= "alsa apm keyboard rtc serial screen usbgadget usbhost vfat"

WKS_FILE ?= "raft-ep-neon-va.wks"
WKS_FILE_DEPENDS ?= " \
    mtools-native \
    dosfstools-native \
    virtual/bootloader \
    virtual/kernel \
    "
```

## wic/raft-ep-neon-va-poky.wks
```
# create a partitioned SD card image for Raft-EP-neon-VA (T113s3) board.

include t113s-boot.wks

part / --source rootfs --ondisk mmcblk0 --fstype=ext4 --label root --align 4 --use-uuid
```

## wic/raft-ep-neon-va-ubuntu.wks
```
# create a partitioned SD card image for Raft-EP-neon-VA (T113s3) board.

include t113s-boot.wks

# This is a hack to let wic use a existing rootfs and setup the permission properly.
# rootfs.py will take care the permission of existing 3rd party files if they are in the --include-path.

part / --source rootfs --rootfs-dir=../downloads/ubuntu-20.04-rootfs/pseudo/empty --include-path=../downloads/ubuntu-20.04-rootfs/pseudo/rootfs --exclude-path=tmp/ --ondisk mmcblk0 --fstype=ext4 --label root --align 4 --use-uuid
```

## wic/t113s-boot.wks
```
# short-description: Create SD card image for T133-Sx SoC
# long-description: Creates a partitioned SD card image for T133-Sx SoC.
# Boot files are loca：ted in the first vfat partition.

part uboot --align 8 --size 128K --ondisk mmcblk0 --source rawcopy --sourceparams="file=u-boot-sunxi-with-spl.bin" --no-table

part /boot --align 4096 --size 20480K --ondisk mmcblk0 --source bootimg-partition --sourceparams="loader=u-boot" --fstype=vfat --label boot --active --use-uuid
```
